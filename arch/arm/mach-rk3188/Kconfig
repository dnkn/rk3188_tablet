## arch/arm/mach-rk3188/Kconfig
```kconfig
choice
	prompt "Rockchip SoC Type"
	depends on ARCH_RK3188

config SOC_RK3188
	bool "RK3188"

endchoice

choice
	prompt "RK3188 Board Type"
	depends on SOC_RK3188

config MACH_RK3188_TB
	bool "RK3188 Top Board"

config MACH_RK3188_FPGA
	bool "RK3188 FPGA board"
	select RK_FPGA

config MACH_RK3188_LR097
        bool "RK3188 LR097 JC21CA board"

config MACH_RK3188_DS1006H
	bool "RK3188 ds1006h board"

config MACH_RK3188_SKQ621
	bool "RK3188 SKQ621 board"
	
config MACH_RK3188_SKQ007A03
	bool "RK3188 SKQ007A03 board"
	
config MACH_RK3188_SKQ026
	bool "RK3188 SKQ026 board"

config MACH_RK3188_SKQ027
	bool "RK3188 SKQ027 board"
config MACH_RK3188_SKQ028
	bool "RK3188 SKQ028 board"	
config MACH_RK3188_SKQ627
	bool "RK3188 SKQ627 board"	
endchoice
```
